## dts/bindings/invensense,mpu6050.yaml
```yaml
description: MPU6050 device driver

compatible: "invensense,mpu6050"

# FILL IN when bringing up hardware, e.g.:
#   include: i2c-device.yaml
#   on-bus: i2c

properties:
  accel-fs:
    description: Accelerometer full-scale range in g
    type: int
    default: 2
    enum:
      - 2
      - 4
      - 8
      - 16

  gyro-fs:
    description: Gyroscope full-scale range in degrees per second
    type: int
    default: 250
    enum:
      - 250
      - 500
      - 1000
      - 2000

  smplrt-div:
    description: Sample rate divider
    type: int
    default: 0
```

## src/Kconfig
```kconfig
config PEROVSAT_MPU6050
	bool "MPU6050 driver"
	depends on DT_HAS_INVENSENSE_MPU6050_ENABLED
	help
	  Enable the MPU6050 Zephyr driver module.

if PEROVSAT_MPU6050

choice
	prompt "MPU6050 backend"
	default PEROVSAT_MPU6050_BACKEND_PUBLIC_MOCK

config PEROVSAT_MPU6050_BACKEND_HARDWARE
	bool "Hardware (real device over bus)"
	help
	  Link lib/mpu6050.c with src/hardware_transfer.c.
	  Fill in that file when bringing the chip up.
	  FILL IN: add "select I2C" (or SPI / SERIAL) on this symbol to match
	  the part.

config PEROVSAT_MPU6050_BACKEND_LIBRARY_MOCK
	bool "Library mock (lib/ without hardware)"
	help
	  Link lib/mpu6050.c with src/lib_mock_transfer.c.

config PEROVSAT_MPU6050_BACKEND_PUBLIC_MOCK
	bool "Public mock (hardcoded data, no library required)"
	help
	  Link mock/mpu6050.c instead of lib/mpu6050.c.
	  Safe for CI and repos without NDA library access.

endchoice

endif
```

## tests/unit/testcase.yaml
```yaml
tests:
  mpu6050-driver.unit:
    tags:
      - drivers
    platform_allow:
      - qemu_cortex_m3
      - rpi_pico2/rp2350a/m33
```
